## CMakeLists.txt
```
#
# Copyright (c) 2018 Nordic Semiconductor
#
# SPDX-License-Identifier: LicenseRef-Nordic-5-Clause
#
cmake_minimum_required(VERSION 3.13.1)

set(CMAKE_EXPORT_COMPILE_COMMANDS ON)

find_package(Zephyr REQUIRED HINTS $ENV{ZEPHYR_BASE})
project("ESIREM_MAIN_FW_nRF52833")

# NORDIC SDK APP START
target_sources(app PRIVATE
  src/main.c
  src/settings.c
  src/ble_service_config.c
  src/ble_service_user.c
  src/ble.c
  src/core.c
)

# NORDIC SDK APP END
zephyr_include_directories(${CMAKE_SOURCE_DIR})
zephyr_library_include_directories(.)
```

## prj.conf
```kconfig
#
# Copyright (c) 2018 Nordic Semiconductor
#
# SPDX-License-Identifier: LicenseRef-Nordic-5-Clause
#

CONFIG_STACK_USAGE=y
CONFIG_MINIMAL_LIBC_MALLOC=y
# 53248 : 52K - 24576 : 24K malloc size for MbedTLS
CONFIG_MINIMAL_LIBC_MALLOC_ARENA_SIZE=16384

# Thread analyzer (for debug)
#CONFIG_THREAD_ANALYZER=y
#CONFIG_THREAD_ANALYZER_USE_PRINTK=y
#CONFIG_THREAD_ANALYZER_AUTO=y
#CONFIG_THREAD_ANALYZER_AUTO_INTERVAL=5

CONFIG_CODCRYPTO=n
CONFIG_CODBLE=n

CONFIG_BT=y
CONFIG_BT_PERIPHERAL=y
CONFIG_BT_DEVICE_NAME="ESIREM_QUANTUM_MAIN"
CONFIG_BT_MAX_CONN=2
CONFIG_BT_SMP=y
CONFIG_BT_SMP_SC_PAIR_ONLY=y
CONFIG_BT_TINYCRYPT_ECC=y
CONFIG_BT_MAX_PAIRED=2
CONFIG_BT_CTLR_PRIVACY=n
# Pas de bonding (pas de sauvegarde 
# des appairages, l'appairage est valide uniquement 
# le temps de la connexion au device)
CONFIG_BT_BONDABLE=y

# Disable some of BLE functions
CONFIG_BT_DATA_LEN_UPDATE=n
CONFIG_BT_PHY_UPDATE=n
CONFIG_BT_GATT_CACHING=n
CONFIG_BT_GATT_SERVICE_CHANGED=n
CONFIG_BT_GAP_PERIPHERAL_PREF_PARAMS=n
CONFIG_BT_SETTINGS_CCC_LAZY_LOADING=n
CONFIG_BT_HCI_VS_EXT=n

# Nécessaire pour activer les long write : write sur characteristique BLE de plus de 20 octets
CONFIG_BT_ATT_PREPARE_COUNT=2

CONFIG_FLASH=y
CONFIG_FLASH_PAGE_LAYOUT=y
CONFIG_FLASH_MAP=y
CONFIG_NVS=y

# Stack sizes
CONFIG_SYSTEM_WORKQUEUE_STACK_SIZE=2048
CONFIG_BT_RX_STACK_SIZE=4096

# Activation du logger sur UART
#CONFIG_LOG_MINIMAL=y
#CONFIG_LOG_IMMEDIATE=n
CONFIG_LOG=y
CONFIG_LOG_PROCESS_TRIGGER_THRESHOLD=1
CONFIG_USE_SEGGER_RTT=y
CONFIG_LOG_BACKEND_UART=n

CONFIG_BT_DIS=y
CONFIG_BT_DIS_PNP=n
CONFIG_BT_DIS_MODEL="ESIREM main board"
CONFIG_BT_DIS_MANUF="ESIREM"
CONFIG_BT_DIS_SERIAL_NUMBER=y
CONFIG_BT_DIS_FW_REV=y
CONFIG_BT_DIS_HW_REV=y
CONFIG_BT_DIS_SW_REV=y
CONFIG_BT_DIS_SERIAL_NUMBER_STR="00000001"
CONFIG_BT_DIS_FW_REV_STR="1.7.0"
CONFIG_BT_DIS_HW_REV_STR="REV-A"
CONFIG_BT_DIS_SW_REV_STR="0.0.1"

# Below is setup to let DIS information be read from settings
CONFIG_BT_SETTINGS=y
CONFIG_SETTINGS_RUNTIME=y
CONFIG_SETTINGS=y

CONFIG_BT_DIS_SETTINGS=y
CONFIG_BT_DIS_STR_MAX=24

# Debug configuration
CONFIG_DEBUG_INFO=y
CONFIG_LED=y

# Bootloader configuration
#CONFIG_USE_DT_CODE_PARTITION=y
```

## src/main.c
```c
/*
 *   ____ ___  ____ ___ _   _ __  __
 *  / ___/ _ \|  _ \_ _| | | |  \/  |
 * | |  | | | | | | | || | | | |  | |
 * | |__| |_| | |_| | || |_| | |  | |
 *  \____\___/|____/___|\___/|_|  |_|
 *
 * (c) 2021 - Codium Electronique
 * Tous droits reserves
 * Ce fichier fait partie du projet ESIREM Quantum main board
 *
 * main.c - 07/12/2021
 * Point d'entree du programme
 */

#include <include/ble.h>
#include <include/core.h>
#include <include/settings.h>

#include <sys/reboot.h>
#include <zephyr.h>

#include <logging/log.h>

LOG_MODULE_REGISTER(esirem_quantum_main, CONFIG_LOG_MAX_LEVEL);

void main(void)
{
    esirem_quantum_main_settings_init();
    if (esirem_quantum_main_core_init())
    {
        LOG_ERR("CRITICAL: failed to init esirem_quantum_main core, entering infinite loop");
        while (1)
        {
            k_sleep(K_MSEC(CONFIG_CODIUM_APP_MAIN_RUN_INTERVAL_MS));
        };
    }
    ble_init();

    for (;;)
    {
        if (esirem_quantum_main_core_error_occured())
        {
            LOG_ERR("Error occured, cold rebooting");
            k_sleep(K_MSEC(1000));
            sys_reboot(SYS_REBOOT_COLD);
        }
        k_sleep(K_MSEC(CONFIG_CODIUM_APP_MAIN_RUN_INTERVAL_MS));
    }
}
```

## include/ble.h
```c
/*
 *   ____ ___  ____ ___ _   _ __  __ 
 *  / ___/ _ \|  _ \_ _| | | |  \/  |
 * | |  | | | | | | | || | | | |  | |
 * | |__| |_| | |_| | || |_| | |  | |
 *  \____\___/|____/___|\___/|_|  |_|
 *
 * (c) 2021 - Codium Electronique
 * Tous droits reserves
 * Ce fichier fait partie du projet ESIREM Quantum main board
 * 
 * ble.h - 07/12/2021
 * Fonctions de gestion du BLE
 */

#ifndef ESIREM_QUANTUM_MAIN_BLE_H_INCLUDED
#define ESIREM_QUANTUM_MAIN_BLE_H_INCLUDED

#ifdef __cplusplus
extern "C" {
#endif

int ble_init(void);

#ifdef __cplusplus
}
#endif

#endif // ESIREM_QUANTUM_MAIN_H_INCLUDED
```

## include/ble_service_config.h
```c
/*
 *   ____ ___  ____ ___ _   _ __  __ 
 *  / ___/ _ \|  _ \_ _| | | |  \/  |
 * | |  | | | | | | | || | | | |  | |
 * | |__| |_| | |_| | || |_| | |  | |
 *  \____\___/|____/___|\___/|_|  |_|
 *
 * (c) 2021 - Codium Electronique
 * Tous droits reserves
 * Ce fichier fait partie du projet ESIREM Quantum main board
 * 
 * ble_service_config.h - 07/12/2021
 * Definitions service BLE configuration ESIREM Quantum board
 * Donne acces a la configuration du dispositif
 */

#ifndef ESIREM_QUANTUM_MAIN_BLE_SERVICE_CONFIG_H_INCLUDED
#define ESIREM_QUANTUM_MAIN_BLE_SERVICE_CONFIG_H_INCLUDED

#ifdef __cplusplus
extern "C" {
#endif

#include <zephyr/types.h>
#include <bluetooth/uuid.h>

/**@bried UUIDs du service installateur / configuration */
#define ESIREM_QUANTUM_MAIN_BLE_UUID_SERVICE_CONFIG 0x01

/**@bried Contrôle du clignotement de la LED */
#define ESIREM_QUANTUM_MAIN_BLE_UUID_SERVICE_CONFIG_CHRC_LED_SEQ_DURATION_MS 0x01
#define ESIREM_QUANTUM_MAIN_BLE_UUID_SERVICE_CONFIG_CHRC_LED_TON_MS 0x02
#define ESIREM_QUANTUM_MAIN_BLE_UUID_SERVICE_CONFIG_CHRC_LED_TOFF_MS 0x03

/**@brief Structures UUIDs BLE pour le service configuration */
extern const struct bt_uuid_128 esirem_quantum_main_ble_uuid_service_config;

extern const struct bt_uuid_128 esirem_quantum_main_ble_uuid_service_config_chrc_led_seq_duration_ms;
extern const struct bt_uuid_128 esirem_quantum_main_ble_uuid_service_config_chrc_led_ton_ms;
extern const struct bt_uuid_128 esirem_quantum_main_ble_uuid_service_config_chrc_led_toff_ms;

#ifdef __cplusplus
}
#endif

#endif // ESIREM_QUANTUM_MAIN_BLE_CONFIG_SERVICE_CONFIG_H_INCLUDED
```

## include/ble_service_user.h
```c
/*
 *   ____ ___  ____ ___ _   _ __  __ 
 *  / ___/ _ \|  _ \_ _| | | |  \/  |
 * | |  | | | | | | | || | | | |  | |
 * | |__| |_| | |_| | || |_| | |  | |
 *  \____\___/|____/___|\___/|_|  |_|
 *
 * (c) 2021 - Codium Electronique
 * Tous droits reserves
 * Ce fichier fait partie du projet ESIREM Quantum main board
 * 
 * ble_service_user.h - 07/12/2021
 */

#ifndef ESIREM_QUANTUM_MAIN_BLE_SERVICE_USER_H_INCLUDED
#define ESIREM_QUANTUM_MAIN_BLE_SERVICE_USER_H_INCLUDED

#ifdef __cplusplus
extern "C" {
#endif

#include <zephyr/types.h>
#include <bluetooth/uuid.h>

/**@brief UUIDs du service utilisateur (declenchement du dispositif) */
#define ESIREM_QUANTUM_MAIN_BLE_UUID_SERVICE_USER 0x02

/**@brief UUIDs caracteristique etat du dispositif */
#define ESIREM_QUANTUM_MAIN_BLE_UUID_SERVICE_USER_CHRC_STATE 0x01

enum esirem_quantum_main_ble_service_user_state {
    ESIREM_QUANTUM_MAIN_SERVICE_USER_STATE_OFF = 0x00UL,
    ESIREM_QUANTUM_MAIN_SERVICE_USER_STATE_ON = 0x01,
};

int esirem_quantum_main_ble_service_user_chrc_state_indicate_change(const bool device_state);

#ifdef __cplusplus
}
#endif

#endif // ESIREM_QUANTUM_MAIN_BLE_SERVICE_USER_H_INCLUDED
```

## include/ble_uuid.h
```c
/*
 *   ____ ___  ____ ___ _   _ __  __
 *  / ___/ _ \|  _ \_ _| | | |  \/  |
 * | |  | | | | | | | || | | | |  | |
 * | |__| |_| | |_| | || |_| | |  | |
 *  \____\___/|____/___|\___/|_|  |_|
 *
 * (c) 2021 - Codium Electronique
 * Tous droits reserves
 * Ce fichier fait partie du projet ESIREM Quantum main board
 *
 * ble_uuid.h - 07/12/2021
 * Definitions macros UUIDs pour les services BLE
 */

#ifndef ESIREM_QUANTUM_MAIN_BLE_UUID_H_INCLUDED
#define ESIREM_QUANTUM_MAIN_BLE_UUID_H_INCLUDED

#ifdef __cplusplus
extern "C"
{
#endif

#include <zephyr/types.h>

/**@brief Timeout pour process d'une requete long write complete */
#define ESIREM_QUANTUM_MAIN_BLE_LONG_WRITE_TIMEOUT_MS (300)

/**@brief Partie vendeur de l'UUID : ESIREM en hex */
#define ESIREM_QUANTUM_MAIN_BLE_UUID_PART_VENDOR 0x45534952454d

/**@brief Partie client de l'UUID : MM en hex */
#define ESIREM_QUANTUM_MAIN_BLE_UUID_PART_CLIENT 0x4d4d

/**@brief Partie projet de l'UUID : MM en hex */
#define ESIREM_QUANTUM_MAIN_BLE_UUID_PART_PROJECT 0x4d4d

/**@brief Partie ID projet de l'UUID */
#define ESIREM_QUANTUM_MAIN_BLE_UUID_PART_PROJECT_ID 0x0001

/**@brief Partie random de l'UUID (2 octets) decales pour
 * laisser la place pour les UUIDs services / caracteristiques */
#define ESIREM_QUANTUM_MAIN_BLE_UUID_PART_RANDOM (0x53a8 << 16)

/**@brief UUID de base pour le projet */
#define ESIREM_QUANTUM_MAIN_BLE_UUID_BASE_VAL                                   \
    BT_UUID_128_ENCODE(                                         \
        ESIREM_QUANTUM_MAIN_BLE_UUID_PART_RANDOM, ESIREM_QUANTUM_MAIN_BLE_UUID_PART_PROJECT_ID, \
        ESIREM_QUANTUM_MAIN_BLE_UUID_PART_PROJECT, ESIREM_QUANTUM_MAIN_BLE_UUID_PART_CLIENT,    \
        ESIREM_QUANTUM_MAIN_BLE_UUID_PART_VENDOR)

#define ESIREM_QUANTUM_MAIN_BLE_UUID_BASE BT_UUID_DECLARE_128(ESIREM_QUANTUM_MAIN_BLE_UUID_BASE_VAL)

#define ESIREM_QUANTUM_MAIN_BLE_UUID_ENCODE_SERVICE(_service)                    \
    BT_UUID_128_ENCODE(                                          \
        (ESIREM_QUANTUM_MAIN_BLE_UUID_PART_RANDOM | (_service << 8)),            \
        ESIREM_QUANTUM_MAIN_BLE_UUID_PART_PROJECT_ID, ESIREM_QUANTUM_MAIN_BLE_UUID_PART_PROJECT, \
        ESIREM_QUANTUM_MAIN_BLE_UUID_PART_CLIENT, ESIREM_QUANTUM_MAIN_BLE_UUID_PART_VENDOR)

#define ESIREM_QUANTUM_MAIN_BLE_UUID_ENCODE_SERVICE_CHRC(_service, _chrc)        \
    BT_UUID_128_ENCODE(                                          \
        (ESIREM_QUANTUM_MAIN_BLE_UUID_PART_RANDOM | (_service << 8) | (_chrc)),  \
        ESIREM_QUANTUM_MAIN_BLE_UUID_PART_PROJECT_ID, ESIREM_QUANTUM_MAIN_BLE_UUID_PART_PROJECT, \
        ESIREM_QUANTUM_MAIN_BLE_UUID_PART_CLIENT, ESIREM_QUANTUM_MAIN_BLE_UUID_PART_VENDOR)

#define ESIREM_QUANTUM_MAIN_BLE_UUID_DECLARE_SERVICE(_service) \
    BT_UUID_DECLARE_128(ESIREM_QUANTUM_MAIN_BLE_UUID_ENCODE_SERVICE(_service))

#define ESIREM_QUANTUM_MAIN_BLE_UUID_DECLARE_SERVICE_CHRC(_service, _chrc) \
    BT_UUID_DECLARE_128(ESIREM_QUANTUM_MAIN_BLE_UUID_ENCODE_SERVICE_CHRC(_service, _chrc))

#define ESIREM_QUANTUM_MAIN_BLE_SERVICE_CHRC_CUD_STR_MAX_LEN 20

#ifdef __cplusplus
}
#endif

#endif // ESIREM_QUANTUM_MAIN_BLE_UUID_H_INCLUDED
```

## include/common.h
```c
/*
 *   ____ ___  ____ ___ _   _ __  __ 
 *  / ___/ _ \|  _ \_ _| | | |  \/  |
 * | |  | | | | | | | || | | | |  | |
 * | |__| |_| | |_| | || |_| | |  | |
 *  \____\___/|____/___|\___/|_|  |_|
 *
 * (c) 2021 - Codium Electronique
 * Tous droits reserves
 * Ce fichier fait partie du projet ESIREM Quantum main board
 * 
 * common.h - 07/12/2021
 * Definitions communes à toute l'appli
 */

#ifndef ESIREM_QUANTUM_MAIN_INCLUDE_COMMON_H_INCLUDED
#define ESIREM_QUANTUM_MAIN_INCLUDE_COMMON_H_INCLUDED

#define STR_LOG_SUCCESS "[OK]\n"
#define STR_LOG_ERR "[FAIL]\n"
#define STR_LOG_ERR_STATUS "[FAIL]: %d\n"

#endif // ESIREM_QUANTUM_MAIN_INCLUDE_COMMON_H_INCLUDED
```

## include/core.h
```c
/*
 *   ____ ___  ____ ___ _   _ __  __
 *  / ___/ _ \|  _ \_ _| | | |  \/  |
 * | |  | | | | | | | || | | | |  | |
 * | |__| |_| | |_| | || |_| | |  | |
 *  \____\___/|____/___|\___/|_|  |_|
 *
 * (c) 2021 - Codium Electronique
 * Tous droits reserves
 * Ce fichier fait partie du projet ESIREM Quantum main board
 *
 * core.h - 07/12/2021
 * Gestion du declenchement / arret du dispositif
 */

#ifndef ESIREM_QUANTUM_MAIN_INCLUDE_CORE_H_INCLUDED
#define ESIREM_QUANTUM_MAIN_INCLUDE_CORE_H_INCLUDED

#include <zephyr.h>
#include <zephyr/types.h>

#include <stdint.h>
#include <stdbool.h>

#ifdef __cplusplus
extern "C"
{
#endif

    enum esirem_quantum_main_core_device_state
    {
        ESIREM_QUANTUM_MAIN_CORE_DEVICE_STATE_IDLE    = 0x00UL,
        ESIREM_QUANTUM_MAIN_CORE_DEVICE_STATE_RUNNING = 0x01UL,
    };

#define ESIREM_QUANTUM_MAIN_CORE_SETTINGS_KEY_STR_MAX_LEN (40)

    extern const char esirem_quantum_main_core_setting_key_module[];
    extern const char esirem_quantum_main_core_setting_key_led_seq_duration_ms[];
    extern const char esirem_quantum_main_core_setting_key_led_ton_duration_ms[];
    extern const char esirem_quantum_main_core_setting_key_led_toff_duration_ms[];

    struct esirem_quantum_main_core_setting_map_uuid_keyptr
    {
        const struct bt_uuid* uuid;
        const char* key;
        uint32_t* ptrval;
        uint16_t keylen;
        const uint32_t* minval;
        const uint32_t* maxval;
    };

    extern const struct esirem_quantum_main_core_setting_map_uuid_keyptr
        esirem_quantum_main_core_setting_map_uuid_keyptr[];

    extern struct settings_handler esirem_quantum_main_core_settings_hdlrs;

    int esirem_quantum_main_core_trig_new_cycle(void);
    int esirem_quantum_main_core_stop_cycle(void);

    uint8_t esirem_quantum_main_core_device_running(void);

    int esirem_quantum_main_core_init(void);

    int esirem_quantum_main_core_setting_get_full_key(
        const struct esirem_quantum_main_core_setting_map_uuid_keyptr* map_uuid_keyptr,
        char* setting_full_key, size_t setting_full_key_sz);
    
    uint32_t esirem_quantum_main_core_setting_get_map_uuid_keyptr_size();

    bool esirem_quantum_main_core_error_occured();

#ifdef __cplusplus
}
#endif

#endif // ESIREM_QUANTUM_MAIN_INCLUDE_CORE_H_INCLUDED
```

## include/settings.h
```c
/*
 *   ____ ___  ____ ___ _   _ __  __ 
 *  / ___/ _ \|  _ \_ _| | | |  \/  |
 * | |  | | | | | | | || | | | |  | |
 * | |__| |_| | |_| | || |_| | |  | |
 *  \____\___/|____/___|\___/|_|  |_|
 *
 * (c) 2021 - Codium Electronique
 * Tous droits reserves
 * Ce fichier fait partie du projet ESIREM Quantum main board
 * 
 * settings.h - 07/12/2021
 * Gestion des parametres en flash
 */

#ifndef ESIREM_QUANTUM_MAIN_INCLUDE_SETTINGS_H_INCLUDED
#define ESIREM_QUANTUM_MAIN_INCLUDE_SETTINGS_H_INCLUDED

#include <zephyr/types.h>

extern const uint32_t settings_val_max_percent;

int esirem_quantum_main_settings_init();

#endif // ESIREM_QUANTUM_MAIN_INCLUDE_SETTINGS_H_INCLUDED
```

## src/ble.c
```c
/*
 *   ____ ___  ____ ___ _   _ __  __
 *  / ___/ _ \|  _ \_ _| | | |  \/  |
 * | |  | | | | | | | || | | | |  | |
 * | |__| |_| | |_| | || |_| | |  | |
 *  \____\___/|____/___|\___/|_|  |_|
 *
 * (c) 2021 - Codium Electronique
 * Tous droits reserves
 * Ce fichier fait partie du projet ESIREM Quantum main board
 *
 * ble.c - 07/12/2021
 * Fonctions de gestion du BLE
 */

#include <include/ble.h>

#include <zephyr.h>
#include <zephyr/types.h>

#include <bluetooth/bluetooth.h>
#include <bluetooth/conn.h>
#include <bluetooth/gatt.h>
#include <bluetooth/hci.h>
#include <bluetooth/uuid.h>

#include <settings/settings.h>

#include <logging/log.h>

#include <include/ble_uuid.h>
#include <include/common.h>
#include <include/ble_service_config.h>

LOG_MODULE_REGISTER(esirem_quantum_main_ble, CONFIG_LOG_MAX_LEVEL);

/* TODO: ajouter la fin du NS dans le nom BLE*/
#define DEVICE_NAME     CONFIG_BT_DEVICE_NAME
#define DEVICE_NAME_LEN (sizeof(DEVICE_NAME) - 1)

static const struct bt_data ble_advert[] = {
    BT_DATA_BYTES(BT_DATA_FLAGS, (BT_LE_AD_GENERAL | BT_LE_AD_NO_BREDR)),
    BT_DATA(BT_DATA_NAME_COMPLETE, DEVICE_NAME, DEVICE_NAME_LEN),
};

static const struct bt_data ble_service_discovery[] = {
    BT_DATA_BYTES(
        BT_DATA_UUID128_ALL,
        ESIREM_QUANTUM_MAIN_BLE_UUID_ENCODE_SERVICE(ESIREM_QUANTUM_MAIN_BLE_UUID_SERVICE_CONFIG)),
};

static void connected(struct bt_conn* conn, uint8_t err)
{
    char str_peer_addr[BT_ADDR_LE_STR_LEN];

    bt_addr_le_to_str(
        bt_conn_get_dst(conn), str_peer_addr, sizeof(str_peer_addr));
    if (err)
    {
        LOG_ERR(
            "Connection to peer %s failed (err %u)\n",
            log_strdup(str_peer_addr), err);
        return;
    }

    // Sécurité level 2 : chiffrement sans authentification (fait par notre cle
    // libsodium avec fonctions maison)
    bt_conn_set_security(conn, BT_SECURITY_L2);

    LOG_DBG("Connected to peer %s", log_strdup(str_peer_addr));
    return;
}

static void disconnected(struct bt_conn* conn, uint8_t reason)
{
    char str_peer_addr[BT_ADDR_LE_STR_LEN];

    bt_addr_le_to_str(
        bt_conn_get_dst(conn), str_peer_addr, sizeof(str_peer_addr));
    LOG_DBG(
        "Disconnected from peer %s, reason %u\n", log_strdup(str_peer_addr),
        reason);
    return;
}

static void security_changed(
    struct bt_conn* conn, bt_security_t level, enum bt_security_err err)
{
    char addr[BT_ADDR_LE_STR_LEN];

    bt_addr_le_to_str(bt_conn_get_dst(conn), addr, sizeof(addr));

    if (!err)
    {
        LOG_DBG("Security changed: %s level %u\n", log_strdup(addr), level);
    }
    else
    {
        LOG_ERR(
            "Security failed: %s level %u err %d\n", log_strdup(addr), level,
            err);
    }
}

static struct bt_conn_cb conn_callbacks = {
    .connected        = connected,
    .disconnected     = disconnected,
    .security_changed = security_changed,
};

static void pairing_confirm(struct bt_conn* conn)
{
    char addr[BT_ADDR_LE_STR_LEN];

    bt_addr_le_to_str(bt_conn_get_dst(conn), addr, sizeof(addr));

    bt_conn_auth_pairing_confirm(conn);

    LOG_DBG("Pairing confirmed: %s\n", log_strdup(addr));
}

static void pairing_complete(struct bt_conn* conn, bool bonded)
{
    char addr[BT_ADDR_LE_STR_LEN];

    bt_addr_le_to_str(bt_conn_get_dst(conn), addr, sizeof(addr));

    LOG_DBG("Pairing completed: %s, bonded: %d\n", log_strdup(addr), bonded);
}

static void pairing_failed(struct bt_conn* conn, enum bt_security_err reason)
{
    char addr[BT_ADDR_LE_STR_LEN];

    bt_addr_le_to_str(bt_conn_get_dst(conn), addr, sizeof(addr));

    LOG_DBG("Pairing failed conn: %s, reason %d\n", log_strdup(addr), reason);
}

static struct bt_conn_auth_cb conn_auth_callbacks = {
    .passkey_display  = NULL, // auth_passkey_display,
    .cancel           = NULL, // auth_cancel,
    .pairing_confirm  = pairing_confirm,
    .pairing_complete = pairing_complete,
    .pairing_failed   = pairing_failed,
};

int ble_init(void)
{
    int err;

    bt_conn_cb_register(&conn_callbacks);
    bt_conn_auth_cb_register(&conn_auth_callbacks);

    err = bt_enable(NULL);
    if (err)
    {
        LOG_ERR("Failed to init ble, err : %d\n", err);
        return err;
    }
    LOG_DBG("BLE initialized\n");

    settings_load();

    err = bt_le_adv_start(
        BT_LE_ADV_CONN, ble_advert, ARRAY_SIZE(ble_advert),
        ble_service_discovery, ARRAY_SIZE(ble_service_discovery));
    if (err)
    {
        LOG_ERR("Failed to start advertising, err: %d\n", err);
        return err;
    }
    LOG_DBG("BLE advertising started\n");

    return 0;
}
```

## src/ble_service_config.c
```c
/*
 *   ____ ___  ____ ___ _   _ __  __
 *  / ___/ _ \|  _ \_ _| | | |  \/  |
 * | |  | | | | | | | || | | | |  | |
 * | |__| |_| | |_| | || |_| | |  | |
 *  \____\___/|____/___|\___/|_|  |_|
 *
 * (c) 2021 - Codium Electronique
 * Tous droits reserves
 * Ce fichier fait partie du projet ESIREM Quantum main board
 *
 * ble_service_config.c - 07/12/2021
 * Donne acces a la configuration du dispositif
 */

#include <include/ble_uuid.h>
#include <include/common.h>
#include <include/ble_service_config.h>
#include <include/core.h>

#include <zephyr/types.h>

#include <errno.h>

#include <bluetooth/bluetooth.h>
#include <bluetooth/conn.h>
#include <bluetooth/gatt.h>
#include <bluetooth/hci.h>
#include <bluetooth/uuid.h>

#include <settings/settings.h>

#include <logging/log.h>

LOG_MODULE_REGISTER(esirem_quantum_main_service_config, CONFIG_LOG_MAX_LEVEL);

/*
 * Fourni un service BLE avec une caracteristique par option de config
 * disponible.
 */

const struct bt_uuid_128 esirem_quantum_main_ble_uuid_service_config =
    BT_UUID_INIT_128(ESIREM_QUANTUM_MAIN_BLE_UUID_ENCODE_SERVICE(ESIREM_QUANTUM_MAIN_BLE_UUID_SERVICE_CONFIG));

const struct bt_uuid_128 esirem_quantum_main_ble_uuid_service_config_chrc_led_seq_duration_ms =
    BT_UUID_INIT_128(ESIREM_QUANTUM_MAIN_BLE_UUID_ENCODE_SERVICE_CHRC(
        ESIREM_QUANTUM_MAIN_BLE_UUID_SERVICE_CONFIG,
        ESIREM_QUANTUM_MAIN_BLE_UUID_SERVICE_CONFIG_CHRC_LED_SEQ_DURATION_MS));
const struct bt_uuid_128 esirem_quantum_main_ble_uuid_service_config_chrc_led_ton_ms =
    BT_UUID_INIT_128(ESIREM_QUANTUM_MAIN_BLE_UUID_ENCODE_SERVICE_CHRC(
        ESIREM_QUANTUM_MAIN_BLE_UUID_SERVICE_CONFIG,
        ESIREM_QUANTUM_MAIN_BLE_UUID_SERVICE_CONFIG_CHRC_LED_TON_MS));
const struct bt_uuid_128 esirem_quantum_main_ble_uuid_service_config_chrc_led_toff_ms =
    BT_UUID_INIT_128(ESIREM_QUANTUM_MAIN_BLE_UUID_ENCODE_SERVICE_CHRC(
        ESIREM_QUANTUM_MAIN_BLE_UUID_SERVICE_CONFIG,
        ESIREM_QUANTUM_MAIN_BLE_UUID_SERVICE_CONFIG_CHRC_LED_TOFF_MS));

static int service_config_get_attr_map_uuid_keyptr(
    const struct bt_gatt_attr* attr,
    const struct esirem_quantum_main_core_setting_map_uuid_keyptr** match_uuid_keyptr)
{
    if (!attr || !match_uuid_keyptr)
    {
        return -EINVAL;
    }

    *match_uuid_keyptr = NULL;
    uint32_t size      = esirem_quantum_main_core_setting_get_map_uuid_keyptr_size();
    for (uint8_t i = 0; i < size; i++)
    {
        if (!bt_uuid_cmp(esirem_quantum_main_core_setting_map_uuid_keyptr[i].uuid, attr->uuid))
        {
            *match_uuid_keyptr = &esirem_quantum_main_core_setting_map_uuid_keyptr[i];
            return 0;
        }
    }

    LOG_ERR("UUID attr not found");
    return -EINVAL;
}

static int service_config_get_full_key_name_from_attr(
    const struct bt_gatt_attr* attr, char* setting_full_key,
    size_t setting_full_key_sz)
{
    const struct esirem_quantum_main_core_setting_map_uuid_keyptr* map_uuid_keyptr = NULL;
    int status                                                     = 0;

    status = service_config_get_attr_map_uuid_keyptr(attr, &map_uuid_keyptr);
    if (status)
    {
        LOG_ERR("Failed to get settings map_uuid_keyptr for attr");
        return status;
    }
    status = esirem_quantum_main_core_setting_get_full_key(
        map_uuid_keyptr, setting_full_key, setting_full_key_sz);
    if (status)
    {
        LOG_ERR("Failed to get full key name for attr");
        return status;
    }
    return 0;
}

static ssize_t service_config_write_cb(
    struct bt_conn* conn, const struct bt_gatt_attr* attr, const void* buf,
    uint16_t len, uint16_t offset, uint8_t flags)
{
    char settings_key_str[ESIREM_QUANTUM_MAIN_CORE_SETTINGS_KEY_STR_MAX_LEN];
    int status = 0;

    LOG_DBG("Write config value");
    status = service_config_get_full_key_name_from_attr(
        attr, settings_key_str, sizeof(settings_key_str));
    if (status)
    {
        return status;
    }
    LOG_DBG("Received write request for %s", log_strdup(settings_key_str));

    status = settings_runtime_set(settings_key_str, buf, sizeof(uint32_t));
    if (status)
    {
        LOG_ERR("Failed to write settings, err: %d", status);
        return BT_GATT_ERR(BT_ATT_ERR_VALUE_NOT_ALLOWED);
    }
    status = settings_save_one(settings_key_str, buf, sizeof(uint32_t));
    if (status)
    {
        LOG_ERR("Failed to save settings to flash, err: %d", status);
        return BT_GATT_ERR(BT_ATT_ERR_VALUE_NOT_ALLOWED);
    }

    return len;
}

static ssize_t service_config_read_cb(
    struct bt_conn* conn, const struct bt_gatt_attr* attr, void* buf,
    uint16_t len, uint16_t offset)
{
    char settings_key_str[ESIREM_QUANTUM_MAIN_CORE_SETTINGS_KEY_STR_MAX_LEN];
    int status       = 0;
    ssize_t data_len = 0;

    LOG_DBG("Read config value");
    status = service_config_get_full_key_name_from_attr(
        attr, settings_key_str, sizeof(settings_key_str));
    if (status)
    {
        return BT_GATT_ERR(BT_ATT_ERR_NOT_SUPPORTED);
    }
    LOG_DBG("Received read request for %s", log_strdup(settings_key_str));

    data_len = settings_runtime_get(settings_key_str, buf, len);
    if (data_len < 0)
    {
        LOG_ERR("Failed to read settings, err: %d", data_len);
        return BT_GATT_ERR(BT_ATT_ERR_NOT_SUPPORTED);
    }

    return data_len;
}

static const char service_config_chrc_led_seq_duration_ms_cud_str[] =
    "Durée total séquence LED (ms)";
static const char service_config_chrc_led_ton_ms_cud_str[]  = "Ton LED (ms)";
static const char service_config_chrc_led_toff_ms_cud_str[] = "Toff LED (ms)";

static const struct bt_gatt_cpf chrc_cpf = {
    .format      = 0x08, /* uint32 */
    .exponent    = 0,
    .unit        = 0,
    .name_space  = 0,
    .description = 0,
};

/* Declaration du service configuration ESIREM_QUANTUM_MAIN */
BT_GATT_SERVICE_DEFINE(
    esirem_quantum_main_service_config,
    BT_GATT_PRIMARY_SERVICE((struct bt_uuid*) &esirem_quantum_main_ble_uuid_service_config),
    BT_GATT_CHARACTERISTIC(
        (struct bt_uuid*) &esirem_quantum_main_ble_uuid_service_config_chrc_led_seq_duration_ms,
        BT_GATT_CHRC_READ | BT_GATT_CHRC_WRITE,
        BT_GATT_PERM_READ | BT_GATT_PERM_WRITE, service_config_read_cb,
        service_config_write_cb, NULL),
    BT_GATT_CUD(
        service_config_chrc_led_seq_duration_ms_cud_str, BT_GATT_PERM_READ),
    BT_GATT_CPF(&chrc_cpf),
    BT_GATT_CHARACTERISTIC(
        (struct bt_uuid*) &esirem_quantum_main_ble_uuid_service_config_chrc_led_ton_ms,
        BT_GATT_CHRC_READ | BT_GATT_CHRC_WRITE,
        BT_GATT_PERM_READ | BT_GATT_PERM_WRITE, service_config_read_cb,
        service_config_write_cb, NULL),
    BT_GATT_CUD(service_config_chrc_led_ton_ms_cud_str, BT_GATT_PERM_READ),
    BT_GATT_CPF(&chrc_cpf),
    BT_GATT_CHARACTERISTIC(
        (struct bt_uuid*) &esirem_quantum_main_ble_uuid_service_config_chrc_led_toff_ms,
        BT_GATT_CHRC_READ | BT_GATT_CHRC_WRITE,
        BT_GATT_PERM_READ | BT_GATT_PERM_WRITE, service_config_read_cb,
        service_config_write_cb, NULL),
    BT_GATT_CUD(service_config_chrc_led_toff_ms_cud_str, BT_GATT_PERM_READ),
    BT_GATT_CPF(&chrc_cpf),);
```

## src/ble_service_user.c
```c
/*
 *   ____ ___  ____ ___ _   _ __  __
 *  / ___/ _ \|  _ \_ _| | | |  \/  |
 * | |  | | | | | | | || | | | |  | |
 * | |__| |_| | |_| | || |_| | |  | |
 *  \____\___/|____/___|\___/|_|  |_|
 *
 * (c) 2021 - Codium Electronique
 * Tous droits reserves
 * Ce fichier fait partie du projet ESIREM Quantum main board
 *
 * ble_service_user.c - 07/12/2021
 * Implementation service utilisateur
 */

#include <include/ble_uuid.h>
#include <include/ble_service_user.h>
#include <include/common.h>
#include <include/core.h>

#include <zephyr/types.h>

#include <errno.h>

#include <bluetooth/bluetooth.h>
#include <bluetooth/conn.h>
#include <bluetooth/gatt.h>
#include <bluetooth/hci.h>
#include <bluetooth/uuid.h>

#include <logging/log.h>

LOG_MODULE_REGISTER(esirem_quantum_main_service_user, CONFIG_LOG_MAX_LEVEL);

static bool notification_enabled = false;

/*
 * Gestion des notifications / indications
 *
 * La pile BLE se charge de garder en mémoire les connexions
 * et paramètres précédents pour chaque pair, et appelle le
 * callback chaque fois que nécessaire (quand un device active
 * un niveau de notification plus élevé, ou quand tous les devices
 * ont désactivés leurs notifs / sont déconnectés).
 *
 * On est assurés que notification_enabled sera toujours a 1
 * tant qu'au moins un appareil a activé les notifications pour
 * l'attribut concerné.
 *
 * La pile maintient un enregistrement de notification pour
 * chaque attribut, chaque attribut peut donc avoir un
 * comportement de notification différent. Ici on utilise
 * qu'un seul attribut avec notification au niveau utilisateur.
 *
 * Voir les fonctions en rapport dans gatt.c
 * (envoi des notifs, update_ccc, gatt_ccc_changed, etc...)
 */

static void
service_user_ccc_cfg_changed(const struct bt_gatt_attr* attr, uint16_t value)
{
    LOG_DBG("CCC config changed: %hx", value);
    notification_enabled = (value == BT_GATT_CCC_NOTIFY);
    return;
}

static ssize_t service_user_state_write_cb(
    struct bt_conn* conn, const struct bt_gatt_attr* attr, const void* buf,
    uint16_t len, uint16_t offset, uint8_t flags)
{
    int ret = 0;

    /* On appelle le callback de changement d'état */
    LOG_DBG("Write user state");
    if (((uint8_t *)buf)[0] != 0x00)
    {
        ret = esirem_quantum_main_core_trig_new_cycle();
        if (ret)
        {
            LOG_DBG("Failed to set state ON");
            return BT_GATT_ERR(BT_ATT_ERR_PROCEDURE_IN_PROGRESS);
        }
    }
    else
    {
        ret = esirem_quantum_main_core_stop_cycle();
        if (ret)
        {
            LOG_DBG("Failed to set state OFF");
            return BT_GATT_ERR(BT_ATT_ERR_PROCEDURE_IN_PROGRESS);
        }
    }

    return len;
}

static ssize_t service_user_state_read_cb(
    struct bt_conn* conn, const struct bt_gatt_attr* attr, void* buf,
    uint16_t len, uint16_t offset)
{
    uint8_t device_state = esirem_quantum_main_core_device_running();
    ssize_t len_read     = 0;

    LOG_DBG("Read user state");
    if (0 == len)
    {
        return BT_GATT_ERR(BT_ATT_ERR_VALUE_NOT_ALLOWED);
    }

    len_read = bt_gatt_attr_read(
        conn, attr, buf, len, offset, &device_state, sizeof(device_state));
    return len_read;
}

static struct bt_uuid_128 service_user_uuid =
    BT_UUID_INIT_128(ESIREM_QUANTUM_MAIN_BLE_UUID_ENCODE_SERVICE(ESIREM_QUANTUM_MAIN_BLE_UUID_SERVICE_USER));
static struct bt_uuid_128 service_user_chrc_state_uuid =
    BT_UUID_INIT_128(ESIREM_QUANTUM_MAIN_BLE_UUID_ENCODE_SERVICE_CHRC(
        ESIREM_QUANTUM_MAIN_BLE_UUID_SERVICE_USER, ESIREM_QUANTUM_MAIN_BLE_UUID_SERVICE_USER_CHRC_STATE));

static const char service_user_chrc_state_cud_str[] = "Etat Quantum main";

static const struct bt_gatt_cpf chrc_state_cpf = {
    .format      = 0x01, /* boolean */
    .exponent    = 0,
    .unit        = 0,
    .name_space  = 0,
    .description = 0,
};

/* Declaration du service utilisateur ESIREM_QUANTUM_MAIN */
BT_GATT_SERVICE_DEFINE(
    esirem_quantum_main_service_user,
    BT_GATT_PRIMARY_SERVICE((struct bt_uuid*) &service_user_uuid),
    BT_GATT_CHARACTERISTIC(
        (struct bt_uuid*) &service_user_chrc_state_uuid,
        BT_GATT_CHRC_READ | BT_GATT_CHRC_WRITE | BT_GATT_CHRC_NOTIFY,
        BT_GATT_PERM_READ | BT_GATT_PERM_WRITE, service_user_state_read_cb,
        service_user_state_write_cb, NULL),
    BT_GATT_CUD(service_user_chrc_state_cud_str, BT_GATT_PERM_READ_ENCRYPT),
    BT_GATT_CCC(
        service_user_ccc_cfg_changed,
        BT_GATT_PERM_READ_ENCRYPT | BT_GATT_PERM_WRITE_ENCRYPT),
    BT_GATT_CPF(&chrc_state_cpf));

/* Envoi d'une notification quand l'etat du device a change */
int esirem_quantum_main_ble_service_user_chrc_state_indicate_change(const bool device_state)
{
    int err;
    uint8_t buf[1] = {0};

    if (!notification_enabled)
    {
        return 0;
    }

    LOG_DBG("Sending notification state changed");

    buf[0] = device_state;

    err = bt_gatt_notify(NULL, &esirem_quantum_main_service_user.attrs[1], buf, sizeof(buf));
    if (err)
    {
        LOG_ERR("Failed to send state indication, err: %d", err);
    }
    return err;
}
```

## src/core.c
```c
/*
 *   ____ ___  ____ ___ _   _ __  __
 *  / ___/ _ \|  _ \_ _| | | |  \/  |
 * | |  | | | | | | | || | | | |  | |
 * | |__| |_| | |_| | || |_| | |  | |
 *  \____\___/|____/___|\___/|_|  |_|
 *
 * (c) 2021 - Codium Electronique
 * Tous droits reserves
 * Ce fichier fait partie du projet ESIREM Quantum main board
 *
 * core.c - 07/12/2021
 *
 * Fonctionnement :
 *
 * - Attente de l'appel d'un callback de declenchement.
 * - Lance une tache dans la file d'attente d'execution du kernel Zephyr.
 * - A chaque execution, la tache controle si elle doit être reexecutee
 * (allumage / coupure de la LED)
 * - Quand le cycle d'execution est termine, la tache se termine sans se
 * remettre en attente
 * - Le systeme repasse en fonctionnement callback : une nouvelle demande lance
 * un nouveau cycle
 * - Si une demande d'arret est reçue pendant un cycle, a la prochaine execution
 * la fonction s'assure que la LED soit eteinte et retourne en attente de
 * nouveau cycle.
 */

#include <include/ble_service_config.h>
#include <include/ble_service_user.h>
#include <include/core.h>
#include <include/settings.h>

#include <device.h>
#include <drivers/gpio.h>
#include <drivers/led.h>
#include <errno.h>
#include <settings/settings.h>
#include <zephyr.h>

#include <stdbool.h>

#include <logging/log.h>

LOG_MODULE_REGISTER(esirem_quantum_main_core, CONFIG_LOG_MAX_LEVEL);

/* The devicetree node identifier for the "led0" alias. */
#define LED0_NODE DT_ALIAS(led0)

#if DT_NODE_HAS_STATUS(LED0_NODE, okay)
#define LED0	DT_GPIO_LABEL(LED0_NODE, gpios)
#define PIN	    DT_GPIO_PIN(LED0_NODE, gpios)
#define FLAGS	DT_GPIO_FLAGS(LED0_NODE, gpios)
#else
/* A build error here means your board isn't set up to blink an LED. */
#error "Unsupported board: led0 devicetree alias is not defined"
#define LED0	""
#define PIN	0
#define FLAGS	0
#endif

enum esirem_quantum_main_core_state
{
    ESIREM_QUANTUM_MAIN_CORE_STATE_IDLE  = 0x00UL,
    ESIREM_QUANTUM_MAIN_CORE_STATE_ON    = 0x01UL,
    ESIREM_QUANTUM_MAIN_CORE_STATE_OFF   = 0x02UL,
    ESIREM_QUANTUM_MAIN_CORE_STATE_ERROR = 0x03UL,
    ESIREM_QUANTUM_MAIN_CORE_STATE_INIT  = 0x04UL,
};

/*
 * Utilise une fonction commit pour valider
 * le chargement des valeurs au démarrage et calculer le count.
 *
 * Utilise une fonction set pour enregistrer une
 * nouvelle valeur qui sera utilisée a la prochaine
 * execution de la fonction run.
 *
 * !! ATTENTION !!
 * Toutes ces variables doivent etres protegees contre les "race conditions"
 * et doivent donc utiliser l'API atomic et donc etre sur 32 bits
 *
 * Si il n'est pas possible d'utiliser une valeur 32 bits (necessite une
 * structure ou autre) utiliser une fonction de lecture et une d'ecriture et
 * proteger la variable par une barriere memoire (mutex, sempahore, a voir
 * suivant les cas)
 */

/**@brief Durée de la sequence de clignotement */
static uint32_t esirem_quantum_main_core_setting_led_seq_duration_ms = 15000;
/**@brief Temps ON LED */
static uint32_t esirem_quantum_main_core_setting_led_ton_duration_ms = 500;
/**@brief Temps OFF LED */
static uint32_t esirem_quantum_main_core_setting_led_toff_duration_ms = 500;
/**@brief Nombre de periodes ON/OFF dans un cycle */
static uint32_t esirem_quantum_main_core_setting_led_period_count = 50;

/*
 * Noms des parametres
 */

const char esirem_quantum_main_core_setting_key_module[] = "esirem_quantum_main";
const char esirem_quantum_main_core_setting_key_led_seq_duration_ms[] =
    "cfg/led/seq_duration_ms";
const char esirem_quantum_main_core_setting_key_led_ton_duration_ms[]  = "cfg/led/ton_ms";
const char esirem_quantum_main_core_setting_key_led_toff_duration_ms[] = "cfg/led/toff_ms";

const struct esirem_quantum_main_core_setting_map_uuid_keyptr
    esirem_quantum_main_core_setting_map_uuid_keyptr[] = {
        {
            .uuid =
                (const struct
                 bt_uuid*) &esirem_quantum_main_ble_uuid_service_config_chrc_led_seq_duration_ms,
            .key    = esirem_quantum_main_core_setting_key_led_seq_duration_ms,
            .ptrval = &esirem_quantum_main_core_setting_led_seq_duration_ms,
            .keylen = sizeof(esirem_quantum_main_core_setting_key_led_seq_duration_ms) - 1,
            .minval = NULL,
            .maxval = NULL,
        },
        {
            .uuid   = (const struct
                     bt_uuid*) &esirem_quantum_main_ble_uuid_service_config_chrc_led_ton_ms,
            .key    = esirem_quantum_main_core_setting_key_led_ton_duration_ms,
            .ptrval = &esirem_quantum_main_core_setting_led_ton_duration_ms,
            .keylen = sizeof(esirem_quantum_main_core_setting_key_led_ton_duration_ms) - 1,
            .minval = NULL,
            .maxval = NULL,
        },
        {
            .uuid   = (const struct
                     bt_uuid*) &esirem_quantum_main_ble_uuid_service_config_chrc_led_toff_ms,
            .key    = esirem_quantum_main_core_setting_key_led_toff_duration_ms,
            .ptrval = &esirem_quantum_main_core_setting_led_toff_duration_ms,
            .keylen = sizeof(esirem_quantum_main_core_setting_key_led_toff_duration_ms) - 1,
            .minval = NULL,
            .maxval = NULL,
        },
};

/* Fonction d'execution d'un declenchement : controle des LEDs */
static atomic_t esirem_quantum_main_led_core_state     = ATOMIC_INIT(ESIREM_QUANTUM_MAIN_CORE_STATE_INIT);
static uint32_t esirem_quantum_main_led_core_work_stop = 0;
static struct k_work_delayable esirem_quantum_main_led_core_work;

const struct device* dev_led = NULL;

static void esirem_quantum_main_led_core_work_run_fn(struct k_work* work)
{
    static uint8_t cur_cycle_count = 0;
    int err                        = 0;

    enum esirem_quantum_main_core_state cur_state =
        (enum esirem_quantum_main_core_state) atomic_get(&esirem_quantum_main_led_core_state);

    uint32_t led_ton_duration_ms =
        (uint32_t) atomic_get(&esirem_quantum_main_core_setting_led_ton_duration_ms);
    uint32_t led_toff_duration_ms =
        (uint32_t) atomic_get(&esirem_quantum_main_core_setting_led_toff_duration_ms);
    uint32_t led_period_count =
        (uint32_t) atomic_get(&esirem_quantum_main_core_setting_led_period_count);

    if (cur_state == ESIREM_QUANTUM_MAIN_CORE_STATE_ERROR)
    {
        LOG_DBG("Exec in error : early exiting");
        return;
    }

    LOG_DBG("Run esirem_quantum_main_core fn");
    switch (cur_state)
    {
        case ESIREM_QUANTUM_MAIN_CORE_STATE_IDLE:
            /* Declenche un nouveau cycle */
            cur_cycle_count = 0;
            /* Pas de break : la LED était eteinte on l'allume */

        case ESIREM_QUANTUM_MAIN_CORE_STATE_OFF:
            /* Passe la LED ON */
            LOG_DBG("Switching LED ON");
            err = gpio_pin_set(dev_led, PIN, 1);
            if (err)
            {
                LOG_ERR("Cannot set PWM");
                atomic_set(
                    &esirem_quantum_main_led_core_state, (atomic_val_t) ESIREM_QUANTUM_MAIN_CORE_STATE_ERROR);
                return;
            }
            atomic_set(&esirem_quantum_main_led_core_state, (atomic_val_t) ESIREM_QUANTUM_MAIN_CORE_STATE_ON);
            /* On planifie la prochaine execution de la fonction pour
             * couper la LED */
            k_work_schedule(&esirem_quantum_main_led_core_work, K_MSEC(led_ton_duration_ms));
            if (!cur_cycle_count)
            {
                esirem_quantum_main_ble_service_user_chrc_state_indicate_change(
                    (bool) ESIREM_QUANTUM_MAIN_CORE_DEVICE_STATE_RUNNING);
            }
            break;

        case ESIREM_QUANTUM_MAIN_CORE_STATE_INIT:
            /* On passe le nombre de cycles au max pour sortir après init
             * comme si on venait de terminer un cycle */
            cur_cycle_count = led_period_count;
        case ESIREM_QUANTUM_MAIN_CORE_STATE_ON:
        default:
            LOG_DBG("Switching LED OFF");
            /* Repasse la LED OFF */
            err = gpio_pin_set(dev_led, PIN, 0);
            if (err)
            {
                LOG_ERR("Cannot set LED OFF");
                atomic_set(
                    &esirem_quantum_main_led_core_state, (atomic_val_t) ESIREM_QUANTUM_MAIN_CORE_STATE_ERROR);
                return;
            }

            if (++cur_cycle_count >= led_period_count
                || (uint32_t) atomic_get(&esirem_quantum_main_led_core_work_stop))
            {
                atomic_set(&esirem_quantum_main_led_core_work_stop, 0x00U);
                atomic_set(
                    &esirem_quantum_main_led_core_state, (atomic_val_t) ESIREM_QUANTUM_MAIN_CORE_STATE_IDLE);
                esirem_quantum_main_ble_service_user_chrc_state_indicate_change(
                    (bool) ESIREM_QUANTUM_MAIN_CORE_DEVICE_STATE_IDLE);
            }
            else
            {
                /* Sinon, on replanifie une execution de la fonction pour
                 * allumer la LED */
                atomic_set(
                    &esirem_quantum_main_led_core_state, (atomic_val_t) ESIREM_QUANTUM_MAIN_CORE_STATE_OFF);
                k_work_schedule(
                    &esirem_quantum_main_led_core_work, K_MSEC(led_toff_duration_ms));
            }
            break;
    }
    return;
}

/* Requete de declenchement d'un nouveau cycle */
int esirem_quantum_main_core_trig_new_cycle(void)
{
    enum esirem_quantum_main_core_state cur_led_state =
        (enum esirem_quantum_main_core_state) atomic_get(&esirem_quantum_main_led_core_state);
    
    if (cur_led_state != ESIREM_QUANTUM_MAIN_CORE_STATE_IDLE)
    {
        return -EBUSY;
    }

    if (!k_work_delayable_is_pending(&esirem_quantum_main_led_core_work))
    {
        k_work_schedule(&esirem_quantum_main_led_core_work, K_NO_WAIT);
    }
    return 0;
}

int esirem_quantum_main_core_stop_cycle(void)
{
    enum esirem_quantum_main_core_state cur_led_state =
        (enum esirem_quantum_main_core_state) atomic_get(&esirem_quantum_main_led_core_state);

    if (cur_led_state == ESIREM_QUANTUM_MAIN_CORE_STATE_IDLE)
        return 0;

    if (cur_led_state != ESIREM_QUANTUM_MAIN_CORE_STATE_OFF
         && cur_led_state != ESIREM_QUANTUM_MAIN_CORE_STATE_ON
         && cur_led_state != ESIREM_QUANTUM_MAIN_CORE_STATE_IDLE)
    {
        return -EBUSY;
    }

    if (cur_led_state != ESIREM_QUANTUM_MAIN_CORE_STATE_IDLE)
        atomic_set(&esirem_quantum_main_led_core_work_stop, 0x01U);

    return 0;
}

bool esirem_quantum_main_core_error_occured()
{
    enum esirem_quantum_main_core_state cur_led_state =
        (enum esirem_quantum_main_core_state) atomic_get(&esirem_quantum_main_led_core_state);

    if (cur_led_state == ESIREM_QUANTUM_MAIN_CORE_STATE_ERROR)
        return true;

    return false;
}

/* Renvoie true si un declenchement est en cours, false sinon */
uint8_t esirem_quantum_main_core_device_running(void)
{
    enum esirem_quantum_main_core_state cur_led_state =
        (enum esirem_quantum_main_core_state) atomic_get(&esirem_quantum_main_led_core_state);

    if (cur_led_state != ESIREM_QUANTUM_MAIN_CORE_STATE_IDLE)
    {
        return 0xFF;
    }
    return 0x00;
}

/* Initialisation du esirem_quantum_main_core */
int esirem_quantum_main_core_init(void)
{
    int scheduled;
    int ret;

    LOG_DBG("Init esirem_quantum_main_core");

    dev_led = device_get_binding(LED0);
    if (NULL == dev_led)
    {
        LOG_ERR("Led device not found");
        return -EIO;
    }

    ret = gpio_pin_configure(dev_led, PIN, GPIO_OUTPUT_ACTIVE | FLAGS);
	if (ret < 0) {
		return -EIO;
	}

    gpio_pin_set(dev_led, PIN, 0);

    atomic_set(
        &esirem_quantum_main_core_setting_led_period_count,
        atomic_get(&esirem_quantum_main_core_setting_led_seq_duration_ms)
            / (atomic_get(&esirem_quantum_main_core_setting_led_ton_duration_ms)
               + atomic_get(&esirem_quantum_main_core_setting_led_toff_duration_ms)));

    /* On lance une premiere execution de la fonction, l'etat
     * est a init, la fonction coupe la LED et repasse en IDLE */
    k_work_init_delayable(&esirem_quantum_main_led_core_work, esirem_quantum_main_led_core_work_run_fn);
    scheduled = k_work_schedule(&esirem_quantum_main_led_core_work, K_NO_WAIT);
    if (!scheduled)
    {
        LOG_ERR("Error while submitting esirem_quantum_main_led_core_work in init");
        return -EIO;
    }
    
    return 0;
}

/*
 * Gestion des parametres
 */

/*
 * Acces aux parametres
 */

static uint32_t esirem_quantum_main_core_setting_map_uuid_keyptr_sz =
    sizeof(esirem_quantum_main_core_setting_map_uuid_keyptr)
    / sizeof(struct esirem_quantum_main_core_setting_map_uuid_keyptr);

uint32_t esirem_quantum_main_core_setting_get_map_uuid_keyptr_size()
{
    return esirem_quantum_main_core_setting_map_uuid_keyptr_sz;
}

static int esirem_quantum_main_core_settings_retrieve_map_uuid_keyptr(
    const char* name,
    const struct esirem_quantum_main_core_setting_map_uuid_keyptr** match_uuid_keyptr)
{
    *match_uuid_keyptr = NULL;

    for (uint8_t i = 0; i < esirem_quantum_main_core_setting_map_uuid_keyptr_sz; i++)
    {
        if (!strncmp(
                name, esirem_quantum_main_core_setting_map_uuid_keyptr[i].key,
                esirem_quantum_main_core_setting_map_uuid_keyptr[i].keylen))
        {
            *match_uuid_keyptr = &esirem_quantum_main_core_setting_map_uuid_keyptr[i];
            return 0;
        }
    }
    LOG_ERR("Invalid name, cannot retrieve data for %s", log_strdup(name));
    return -EINVAL;
}

/**@brief Appele pendant le chargement / la modification de valeur via settings
 * API pour modifier la valeur d'un parametre.
 */
static int esirem_quantum_main_core_settings_set(
    const char* name, size_t len, settings_read_cb read_cb, void* cb_arg)
{
    int status                                                     = 0;
    uint32_t tmp_val                                               = 0;
    const struct esirem_quantum_main_core_setting_map_uuid_keyptr* map_uuid_keyptr = NULL;

    LOG_DBG("Write config value");
    status = esirem_quantum_main_core_settings_retrieve_map_uuid_keyptr(name, &map_uuid_keyptr);
    if (status || !map_uuid_keyptr)
    {
        return status;
    }

    if (len != sizeof(uint32_t))
    {
        LOG_ERR("Invalid size");
        return -EINVAL;
    }

    status = read_cb(cb_arg, &tmp_val, sizeof(uint32_t));
    if (status < 0)
    {
        LOG_ERR("Failed to read settings value");
        return status;
    }

    if ((map_uuid_keyptr->minval && tmp_val < *map_uuid_keyptr->minval)
        || (map_uuid_keyptr->maxval && tmp_val > *map_uuid_keyptr->maxval))
    {
        LOG_ERR(
            "Invalid value for setting %s", log_strdup(map_uuid_keyptr->key));
        return -EINVAL;
    }

    if (
        map_uuid_keyptr->ptrval == &esirem_quantum_main_core_setting_led_seq_duration_ms
        || map_uuid_keyptr->ptrval == &esirem_quantum_main_core_setting_led_ton_duration_ms
        || map_uuid_keyptr->ptrval == &esirem_quantum_main_core_setting_led_toff_duration_ms)
    {
        atomic_set(
            &esirem_quantum_main_core_setting_led_period_count,
            atomic_get(&esirem_quantum_main_core_setting_led_seq_duration_ms)
                / (atomic_get(&esirem_quantum_main_core_setting_led_ton_duration_ms)
                   + atomic_get(&esirem_quantum_main_core_setting_led_toff_duration_ms)));
    }

    LOG_DBG("Config value %s changed", log_strdup(map_uuid_keyptr->key));
    return 0;
}

static int esirem_quantum_main_core_settings_get(const char* key, char* val, int val_len_max)
{
    int status                                                     = 0;
    const struct esirem_quantum_main_core_setting_map_uuid_keyptr* map_uuid_keyptr = NULL;

    LOG_DBG("Getting esirem_quantum_maincore settings");
    status = esirem_quantum_main_core_settings_retrieve_map_uuid_keyptr(key, &map_uuid_keyptr);
    if (status)
    {
        return status;
    }

    if (val_len_max < sizeof(uint32_t))
    {
        LOG_ERR("buf for value too short");
        return -EINVAL;
    }

    memcpy(val, map_uuid_keyptr->ptrval, sizeof(uint32_t));
    return sizeof(uint32_t);
}

/**@brief appele apres la fin du chargement des parametres. */
static int esirem_quantum_main_core_settings_commit(void)
{
    atomic_set(
        &esirem_quantum_main_core_setting_led_period_count,
        atomic_get(&esirem_quantum_main_core_setting_led_seq_duration_ms)
            / (atomic_get(&esirem_quantum_main_core_setting_led_ton_duration_ms)
               + atomic_get(&esirem_quantum_main_core_setting_led_toff_duration_ms)));

    return 0;
}

struct settings_handler esirem_quantum_main_core_settings_hdlrs = {
    .name     = esirem_quantum_main_core_setting_key_module,
    .h_set    = esirem_quantum_main_core_settings_set,
    .h_get    = esirem_quantum_main_core_settings_get,
    .h_commit = esirem_quantum_main_core_settings_commit,
};

int esirem_quantum_main_core_setting_get_full_key(
    const struct esirem_quantum_main_core_setting_map_uuid_keyptr* map_uuid_keyptr,
    char* setting_full_key, size_t setting_full_key_sz)
{
    if (!map_uuid_keyptr || !setting_full_key
        || setting_full_key_sz < ESIREM_QUANTUM_MAIN_CORE_SETTINGS_KEY_STR_MAX_LEN)
    {
        return -EINVAL;
    }

    memcpy(
        setting_full_key, esirem_quantum_main_core_setting_key_module,
        sizeof(esirem_quantum_main_core_setting_key_module) - 1);
    setting_full_key[sizeof(esirem_quantum_main_core_setting_key_module) - 1] = '/';

    if (map_uuid_keyptr->keylen > ESIREM_QUANTUM_MAIN_CORE_SETTINGS_KEY_STR_MAX_LEN
                                      - sizeof(esirem_quantum_main_core_setting_key_module))
    {
        LOG_ERR("buffer too short for full key name");
        return -EINVAL;
    }

    strncpy(
        &setting_full_key[sizeof(esirem_quantum_main_core_setting_key_module)],
        map_uuid_keyptr->key, map_uuid_keyptr->keylen);

    return 0;
}
```
